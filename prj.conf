## CMakeLists.txt
```
# SPDX-License-Identifier: Apache-2.0

cmake_minimum_required(VERSION 3.20.0)
find_package(Zephyr REQUIRED HINTS $ENV{ZEPHYR_BASE})
project(vl53l0x_harry)

FILE(GLOB app_sources src/*.c)
target_sources(app PRIVATE ${app_sources})
```

## sample.yaml
```
sample:
  description: Send data to Golioth Light DB stream
  name: lightdb stream
common:
  harness: net
  platform_allow: >
    esp32
    nrf52840dk_nrf52840
    nrf9160dk_nrf9160_ns
    qemu_x86
    disco_l475_iot1
  tags: golioth net socket
tests:
  sample.golioth.lightdb_stream: {}
```

## prj.conf
```kconfig
#taken from /home/harrkout/zephyr/samples/sensor/vl53l0x/prj.conf

CONFIG_STDOUT_CONSOLE=y
CONFIG_I2C=y
CONFIG_GPIO=y
CONFIG_SENSOR=y
CONFIG_VL53L0X=y
CONFIG_VL53L0X_PROXIMITY_THRESHOLD=100

#debug
#CONFIG_DEBUG=y
#CONFIG_LOG=y
#CONFIG_SENSOR_LOG_LEVEL_DBG=y
CONFIG_CBPRINTF_FP_SUPPORT=y


#Taken from /home/harrkout/modules/lib/golioth/samples/lightdb_stream/prj.conf

# Generic networking options
CONFIG_NETWORKING=y
CONFIG_NET_IPV4=y
CONFIG_NET_IPV6=n

# Logging
CONFIG_NET_LOG=y

# Network Shell
CONFIG_NET_SHELL=y

# TLS configuration
CONFIG_MBEDTLS_ENABLE_HEAP=y
CONFIG_MBEDTLS_HEAP_SIZE=10240
CONFIG_MBEDTLS_SSL_MAX_CONTENT_LEN=2048

# Application
CONFIG_MAIN_STACK_SIZE=4096
CONFIG_EVENTFD=y

CONFIG_GOLIOTH=y
CONFIG_GOLIOTH_SYSTEM_CLIENT=y

CONFIG_MINIMAL_LIBC_MALLOC_ARENA_SIZE=1024

CONFIG_WIFI=y
CONFIG_WIFI_ESP_AT=y
CONFIG_WIFI_ESP_AT_MDM_RX_BUF_COUNT=40

CONFIG_NET_L2_WIFI_SHELL=y
CONFIG_GOLIOTH_SAMPLE_WIFI=y

CONFIG_GOLIOTH_SYSTEM_CLIENT_PSK_ID="secret@l475"
CONFIG_GOLIOTH_SYSTEM_CLIENT_PSK="secret_id"

CONFIG_GOLIOTH_SAMPLE_WIFI_SSID="***"
CONFIG_GOLIOTH_SAMPLE_WIFI_PSK="***"
```

## boards/disco_l475_iot1.overlay
```dts
/*
 * Copyright (c) 2019 Linaro Limited
 *
 * SPDX-License-Identifier: Apache-2.0
 */

/ {
	resources {
		compatible = "test-gpio-basic-api";
		out-gpios = <&arduino_header 6 0>; /* Arduino D0 */
		in-gpios = <&arduino_header 7 0>;  /* Arduino D1 */
	};
};
```

## src/main.c
```c
/*
 * Harry Koutsourelakis 01/06/22
 */

//Golioth's header files
#include <logging/log.h>
LOG_MODULE_REGISTER(golioth_lightdb_stream, LOG_LEVEL_DBG);

#include <net/coap.h>
#include <net/golioth/system_client.h>
#include <net/golioth/wifi.h>

#include <drivers/sensor.h>
#include <stdlib.h>

//VL53L0X header files

#include <zephyr.h>
#include <device.h>
#include <drivers/sensor.h>
#include <stdio.h>
#include <sys/printk.h>

//Enables Golioth client
static struct golioth_client *client = GOLIOTH_SYSTEM_CLIENT_GET();			


void main(void)
{

	const struct device *dev = device_get_binding(DT_LABEL(DT_INST(0, st_vl53l0x)));
	//struct for reading the sensor values (universal library in zephyr, I think?).
	struct sensor_value dist, prox;

	//strings are used to save the data, because Golioth uses CoAP Protocol and can send only Plain Text.
	char str_distance[64];
	char str_proximity[32];
	int ret;

	//Message at the beginning of project (in UART).
	LOG_DBG("Starting LightDB Stream of Time-of-Flight Sensor");

	//Enables Golioth's wifi settings.
	if (IS_ENABLED(CONFIG_GOLIOTH_SAMPLE_WIFI)) {
		LOG_INF("Connecting to WiFi");
		wifi_connect();
	}

	if (dev == NULL) {
		printk("Could not get VL53L0X device\n");
		return;
	}

	//Clients starts.
	golioth_system_client_start();

	//Checks whether the VL53L0X sensor is available.
	while (true) {
		ret = sensor_sample_fetch(dev);
		if (ret) {
			printk("sensor_sample_fetch failed ret %d\n", ret);
			return;
			k_sleep(K_SECONDS(1));
			continue;
		}

		str_distance[sizeof(sensor_value_to_double(&dist)) - 1] = '\0';
		str_proximity[sizeof(prox)] = '\0';


		//Proximity

		//Variable ret saves the state of the data taken from the sensor.
		ret = sensor_channel_get(dev, SENSOR_CHAN_PROX, &prox);
		//Prints in UART the received data.
		printk("========================================================================================\n");
		printk("\n					    ST_VL53L0X Data: \n\n");
		printk("					-------------------------\n", prox);
		printk("					|  Proximity is %d       |\n", prox);
		
		//Distance

		ret = sensor_channel_get(dev, SENSOR_CHAN_DISTANCE, &dist);
		printf("					|  Distance is %.3fm   |\n", sensor_value_to_double(&dist));
		printk("					-------------------------\n", prox);


		//snprintk && snprintf(same usage in Zephyr, I think?) are necessary to send log to LightDB Stream.

		/* USAGE:
		*
		* Composes a string with the same text that would be printed if format was used on printf, but instead of being printed,
		* the content is stored as a C string in the buffer pointed by s (taking n as the maximum buffer capacity to fill).
		*
		*/

		snprintf(str_proximity, sizeof(str_proximity),
			 "%d", prox);

		str_proximity[sizeof(str_proximity) -1 ] = '\0';

		snprintf(str_distance, sizeof(str_distance),

			 "%.3fm", sensor_value_to_double(&dist));
		str_distance[sizeof(str_distance) - 1] = '\0';

		//Message the is shown in UART if Golioth Client is correctly sending data.
		LOG_DBG("Sending Distance %sm\  /|  Proximity %s\n", log_strdup(str_distance), log_strdup(str_proximity));
		printk("================================================================================================\n");


		ret = golioth_lightdb_set(client,
					  GOLIOTH_LIGHTDB_STREAM_PATH("Time-of-Flight: Distance"),
					  COAP_CONTENT_FORMAT_TEXT_PLAIN,
					  str_distance,
					  strlen(str_distance));

		ret = golioth_lightdb_set(client,
					  GOLIOTH_LIGHTDB_STREAM_PATH("Time-of-Flight: Proximity"),
					  COAP_CONTENT_FORMAT_TEXT_PLAIN,
					  str_proximity,
					  strlen(str_proximity));

		if (ret) {
			LOG_WRN("Failed to send data: %d", ret);
		}

		k_sleep(K_MSEC(1000));
	}
}
```
